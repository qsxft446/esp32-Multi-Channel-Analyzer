## main/Kconfig.projbuild
```kconfig
menu "MCA configuration"

    config MCA_WIFI_SSID
        string "WiFi SSID"
        default "myssid"

    config MCA_WIFI_PASS
        string "WiFi password"
        default "mypassword"

endmenu
```
